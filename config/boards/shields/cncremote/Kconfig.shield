## config/boards/shields/cncremote/Kconfig.shield
```kconfig
# Copyright (c) 2022 The ZMK Contributors
# SPDX-License-Identifier: MIT

config SHIELD_cncremote
  def_bool $(shields_list_contains,cncremote)
```
